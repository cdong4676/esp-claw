## application/edge_agent/boards/elegoo_esp32_s3_superkit/sdkconfig.defaults.board
```kconfig
CONFIG_ESP_BOARD_PERIPH_LEDC_SUPPORT=y
CONFIG_ESP_BOARD_PERIPH_I2C_SUPPORT=y

CONFIG_ESP_BOARD_DEV_DISPLAY_LCD_SUPPORT=y
CONFIG_ESP_EMOTE_SUPPORT=n
CONFIG_APP_CLAW_ENABLE_EMOTE=n
CONFIG_ESP_BOARD_DEV_LEDC_CTRL_SUPPORT=y


CONFIG_ESP_DEFAULT_CPU_FREQ_MHZ_240=y

# Flash 配置
CONFIG_ESPTOOLPY_FLASHSIZE_16MB=y
CONFIG_ESPTOOLPY_FLASHMODE_QIO=y
CONFIG_ESPTOOLPY_FLASHFREQ_80M=y

# 分区表配置
CONFIG_PARTITION_TABLE_CUSTOM=y
CONFIG_PARTITION_TABLE_CUSTOM_FILENAME="partitions_16MB.csv"

# PSRAM 配置（表情资产加载需要大量内存）
CONFIG_SPIRAM=y
CONFIG_SPIRAM_MODE_OCT=y
CONFIG_SPIRAM_SPEED_80M=y
```
