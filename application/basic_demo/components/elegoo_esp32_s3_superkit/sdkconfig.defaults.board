## application/basic_demo/components/elegoo_esp32_s3_superkit/sdkconfig.defaults.board
```kconfig
CONFIG_ESP_BOARD_PERIPH_I2S_SUPPORT=y
CONFIG_ESP_BOARD_PERIPH_SPI_SUPPORT=y
CONFIG_ESP_BOARD_PERIPH_LEDC_SUPPORT=y
CONFIG_ESP_BOARD_PERIPH_I2C_SUPPORT=y

CONFIG_ESP_BOARD_DEV_AUDIO_CODEC_SUPPORT=y
CONFIG_ESP_BOARD_DEV_CAMERA_SUPPORT=y
CONFIG_ESP_BOARD_DEV_CAMERA_SUB_DVP_SUPPORT=y
CONFIG_ESP_BOARD_DEV_DISPLAY_LCD_SUPPORT=y
CONFIG_ESP_BOARD_DEV_DISPLAY_LCD_SUB_SPI_SUPPORT=y
CONFIG_ESP_BOARD_DEV_LEDC_CTRL_SUPPORT=y


CONFIG_ESP_DEFAULT_CPU_FREQ_MHZ_240=y

# Flash 配置
CONFIG_ESPTOOLPY_FLASHSIZE_16MB=y
CONFIG_ESPTOOLPY_FLASHMODE_QIO=y
CONFIG_ESPTOOLPY_FLASHFREQ_80M=y

# 分区表配置
CONFIG_PARTITION_TABLE_CUSTOM=y
CONFIG_PARTITION_TABLE_CUSTOM_FILENAME="partitions_16MB.csv"

# PSRAM 配置（表情资产加载需要大量内存）
CONFIG_SPIRAM=y
CONFIG_SPIRAM_MODE_OCT=y
CONFIG_SPIRAM_SPEED_80M=y

#CONFIG_SPIRAM_USE_MALLOC=y

# 编译器优化级别（避免 GCC 14.2.0 bug）
CONFIG_COMPILER_OPTIMIZATION_NONE=y

CONFIG_FATFS_LFN_HEAP=y
CONFIG_FATFS_MAX_LFN=255

# 增加主任务栈大小（表情资产加载需要较大栈空间）
#CONFIG_MAIN_TASK_STACK_SIZE=9216

# 增加系统事件任务栈大小（WiFi 事件处理需要较大栈空间）
#CONFIG_ESP_SYSTEM_EVENT_TASK_STACK_SIZE=4096

# UART0 引脚重映射（释放 GPIO43/44 给 LCD 使用）
CONFIG_ESP_CONSOLE_UART_CUSTOM=y
CONFIG_ESP_CONSOLE_UART_TX_GPIO=45
CONFIG_ESP_CONSOLE_UART_RX_GPIO=48

#开启摄像头传感器
CONFIG_CAMERA_OV2640=y
CONFIG_CAMERA_OV2640_AUTO_DETECT_DVP_INTERFACE_SENSOR=y
CONFIG_CAMERA_OV2640_DVP_JPEG_640X480_25FPS=y
CONFIG_CAMERA_OV2640_DVP_DEFAULT_FMT_JPEG_640X480_25FPS=y
CONFIG_CAMERA_OV2640_DVP_IF_FORMAT_INDEX_DEFAULT=2
CONFIG_ESP_VIDEO_ENABLE_DVP_CAMERA_MOTOR=y
```
